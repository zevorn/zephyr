## boards/canaan/canmv_k230/Kconfig.defconfig
```kconfig
# Copyright (c) 2026 Process Mission
# SPDX-License-Identifier: Apache-2.0

if BOARD_CANMV_K230

config SYS_CLOCK_TICKS_PER_SEC
	default 1000

endif # BOARD_CANMV_K230
```

## boards/canaan/canmv_k230/board.yml
```yaml
board:
  name: canmv_k230
  full_name: CanMV-K230
  vendor: canaan
  socs:
    - name: k230
```

## soc/canaan/k230/Kconfig.defconfig
```kconfig
# Copyright (c) 2026 Process Mission
# SPDX-License-Identifier: Apache-2.0

if SOC_K230_C908

config RISCV_SOC_INTERRUPT_INIT
	default y

config 2ND_LVL_ISR_TBL_OFFSET
	default 12

config 2ND_LVL_INTR_00_OFFSET
	default 11

config MAX_IRQ_PER_AGGREGATOR
	default 209

config NUM_IRQS
	default 221

config SYS_CLOCK_HW_CYCLES_PER_SEC
	default $(dt_node_int_prop_int,/cpus,timebase-frequency)

configdefault UART_NS16550_ACCESS_WORD_ONLY
	default y

endif # SOC_K230_C908
```
